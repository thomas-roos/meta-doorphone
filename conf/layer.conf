## conf/layer.conf
```bitbake
# We have a conf and classes directory, add to BBPATH
BBPATH .= ":${LAYERDIR}"

# We have a packages directory, add to BBFILES
BBFILES += "${LAYERDIR}/recipes-*/*/*.bb \
            ${LAYERDIR}/recipes-*/*/*.bbappend"

BBFILE_COLLECTIONS += "tro-layer"
BBFILE_PATTERN_tro-layer := "^${LAYERDIR}/"
BBFILE_PRIORITY_tro-layer = "100"

# This should only be incremented on significant changes that will
# cause compatibility issues with other layers
LAYERVERSION_tro-layer = "1"

LAYERDEPENDS_tro-layer = "core"
LAYERDEPENDS_tro-layer += "openembedded-layer"
LAYERDEPENDS_tro-layer += "meta-python"

LAYERSERIES_COMPAT_tro-layer = "scarthgap whinlatter"

LICENSE_PATH += "${LAYERDIR}/licenses"
```
